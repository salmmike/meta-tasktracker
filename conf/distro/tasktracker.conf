## conf/distro/tasktracker.conf
```bitbake
require conf/distro/poky.conf

DISTRO = "tasktracker"
DISTRO_NAME = "Tasktracker Linux distribution"
DISTRO_VERSION = "0.0.2"

DISTRO_FEATURES:append = " systemd pam fontconfig tslib wayland opengl "
DISTRO_FEATURES:remove = "x11 "
DISTRO_FEATURES_BACKFILL_CONSIDERED = "sysvinit"
VIRTUAL-RUNTIME_init_manager = "systemd"
VIRTUAL-RUNTIME_initscripts = ""
```

## conf/layer.conf
```bitbake
# We have a conf and classes directory, add to BBPATH
BBPATH .= ":${LAYERDIR}"

# We have recipes-* directories, add to BBFILES
BBFILES += "${LAYERDIR}/recipes-*/*/*.bb \
            ${LAYERDIR}/recipes-*/*/*.bbappend"

BBFILE_COLLECTIONS += "meta-tasktracker"
BBFILE_PATTERN_meta-tasktracker = "^${LAYERDIR}/"
BBFILE_PRIORITY_meta-tasktracker = "8"

LAYERDEPENDS_meta-tasktracker = "core"
LAYERSERIES_COMPAT_meta-tasktracker = "mickledore"
```
